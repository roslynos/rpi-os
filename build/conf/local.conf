## build/conf/local.conf
```bitbake
# Machine Selection
MACHINE ?= "raspberrypi4-64"

# The distribution setting controls which policy settings are used as defaults.
DISTRO ?= "roslynos"

# Package Management configuration
PACKAGE_CLASSES ?= "package_ipk"

# Enable opkg package managment features 
PACKAGE_FEED_URIS = "http://whisk.roslynos.com"
PACKAGE_FEED_BASE_PATHS = "ipk"

# Activate build history for the PR service
INHERIT += "buildhistory"
BUILDHISTORY_COMMIT = "1"

# Additional image features
USER_CLASSES ?= "buildstats"

# Removes work files after the openembedded build system has finished.
INHERIT += "rm_work"

# Interactive shell configuration
PATCHRESOLVE = "noop"

# Allow 1 thread for github remote runner
# PARALLEL_MAKE = "-j 7"
# BB_NUMBER_THREADS = "7"

# IP Compliance - WiFi/BT firmware
LICENSE_FLAGS_ACCEPTED = "synaptics-killswitch"

# Enable wic format for flashing to 16GB sdcard
WKS_FILE = "rpi-boot-image.wks"
IMAGE_FSTYPES = "wic.bmap wic.gz"

# Disk Space Monitoring during the build
BB_DISKMON_DIRS ??= "\
    STOPTASKS,${TMPDIR},1G,100K \
    STOPTASKS,${DL_DIR},1G,100K \
    STOPTASKS,${SSTATE_DIR},1G,100K \
    STOPTASKS,/tmp,100M,100K \
    HALT,${TMPDIR},100M,1K \
    HALT,${DL_DIR},100M,1K \
    HALT,${SSTATE_DIR},100M,1K \
    HALT,/tmp,10M,1K"

# configuration version
CONF_VERSION = "2"
```
